#include <behaviors.dtsi>
#include <dt-bindings/zmk/keys.h>

/ {
    keymap {
        compatible = "zmk,keymap";

        default {
            display-name = "Trackball";
            bindings = <&none>;
        };
    };
};
